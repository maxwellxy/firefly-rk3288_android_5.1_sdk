## kernel/drivers/video/rockchip/rgb2hdmi/Kconfig
```kconfig
config FIREFLY_RGB2HDMI
        bool "Firefly RGB2HDMI Out support"
        help
          Support Firefly rgb2hdmi if you say y here
```

## kernel/drivers/video/rockchip/vga/Kconfig
```kconfig
menuconfig FIREFLY_VGA
        bool "Firefly VGA Out/In support"
        help
          Support Firefly VGA in if you say y here

config FIREFLY_VGA_OUT_ONLY
	tristate "Firefly VGA Out Only"
	depends on FIREFLY_VGA
	help
	  Support Firefly VGA Only Out in if you say y here
```
